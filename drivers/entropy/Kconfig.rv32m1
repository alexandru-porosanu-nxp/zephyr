## drivers/entropy/Kconfig.rv32m1
```kconfig
menuconfig ENTROPY_RV32M1_TRNG
	bool "RV32M1 TRNG driver"
	depends on ENTROPY_GENERATOR && SOC_OPENISA_RV32M1_RISCV32
	select ENTROPY_HAS_DRIVER
	help
	  This option enables the true random number generator (TRNG)
	  driver based on the RV32M1 TRNG driver.
```
